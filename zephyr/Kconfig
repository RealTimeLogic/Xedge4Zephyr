## zephyr/Kconfig
```kconfig
# Xedge RTOS Module Configuration
# This file provides Kconfig options for the Xedge module

menuconfig XEDGE
	bool "Xedge Barracuda App Server Support"
	default n
	depends on NETWORKING
	depends on NET_SOCKETS
	help
	  Enable Xedge RTOS, which provides the Barracuda App Server
	  with embedded HTTP(S) server, WebSocket support, and Lua runtime
	  for rapid IoT application development.

if XEDGE

config XEDGE_STACK_SIZE
	int "Xedge/BAS server thread stack size"
	default 24000
	help
	  Sets the Barracuda App Server (BAS) macro BA_STACKSZ

config XEDGE_THREAD_PRIORITY
	int "Xedge server thread priority"
	default 5
	range 2 15
	help
	  Priority for the Xedge server thread.
	  Lower values = higher priority.

config XEDGE_ENABLE_DISK_IO
	bool "Enable disk I/O support"
	default y
	depends on FILE_SYSTEM
	help
	  Enable file system support for Xedge.
	  Requires Zephyr file system to be configured.

config XEDGE_HEAP_SIZE
	int "Xedge heap size for dlmalloc"
	default 2097152
	help
	  Heap size in bytes for Xedge's dlmalloc allocator.
	  Default: 2MB. Adjust based on your application needs.

config XEDGE_ENABLE_DEBUGGER
	bool "Enable Lua debugger support"
	default y
	help
	  Enable Lua debugging capabilities.
	  This increases code size but allows remote debugging.

config XEDGE_ENABLE_ENCRYPTION_KEY
	bool "Enable softTPM key material"
	default y
	depends on !XEDGE_PSA
	help
	  When enabled, create your own secret encryption key.
          See BAS/examples/xedge/src/EncryptionKey.h

config XEDGE_PSA
	bool "Use TF-M PSA for the TPM and TLS cryptography"
	depends on BUILD_WITH_TFM && TFM_PARTITION_CRYPTO
	depends on TFM_PARTITION_INTERNAL_TRUSTED_STORAGE
	default n
	help
	  Use the secure firmware's PSA provider. The build automatically
	  packages psatpm.lua as Xedge's tpm.lua.
	  This example uses the automatically created device root for both
	  globalkey and uniquekey; encrypted settings are device-specific.

config XEDGE_ENABLE_SHARKTRUST
	bool "Enable SharkTrustX"
	default y
	help
	  See https://realtimelogic.com/products/SharkTrustX/
          Generate your own: BAS/examples/xedge/src/tokengen.c

config XEDGE_ENABLE_REVCON
	bool "Enable the SharkTrustX reverse connection"
	default y
	help
	  Sets macro USE_REVCON
          Details: http://realtimelogic.com/ba/examples/xedge/readme.html#features

config XEDGE_ENABLE_ZIPSIGNATURE
	bool "Enable ZIP file signature check"
	default n
	help
	  See https://realtimelogic.com/ba/doc/en/C/reference/html/SignEncZip.html
          See also BAS/examples/xedge/src/ZipPublicKey.h

config XEDGE_MAX_THREADS
	int "Maximum number of threads"
	default 2
	range 1 10
	help
	  Maximum number of concurrent threads for the server.

config XEDGE_HTTP_CONNECTIONS
	int "HTTP and HTTPS connection capacity"
	default 16
	range 4 65535
	help
	  Number of BAS connection slots shared by HTTP and HTTPS, including
	  idle persistent connections. BAS raises this to at least its HTTP
	  command count plus three. This does not add worker threads.
	  Active connections also need TLS memory and Zephyr network resources.
	  Reserve network capacity for listeners, DNS and outbound clients.

config XEDGE_RESOURCE_FLASH
	bool "Read the embedded Xedge resource ZIP through the flash driver"
	default n
	depends on FLASH_MAP
	help
	  Store the generated XedgeZip.c payload in the XEDGE_RESOURCES linker
	  memory region and read it through the xedge_resources flash partition.
	  The board must provide both at the same external flash offset. Use
	  HEX or ELF output when program and resources occupy distant addresses.
	  Default: disabled; the generated memory ZIP reader is used instead.



endif # XEDGE
```
